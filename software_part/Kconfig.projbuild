## software_part/components/01_application/my_ui/Kconfig.projbuild
```kconfig
menu "Chatbot Service Options"

config MY_UI_CHATBOT_ENABLE
    bool "Enable Chatbot WebSocket client"
    default n
    help
        When enabled, the device will send text from the GPT screen to
        ws://HOST:PORT/PATH and render assistant responses in the chat log.

config MY_UI_CHATBOT_HOST
    string "Chatbot host or mDNS name"
    default "servers.local"
    help
        Hostname, mDNS name or IP of the Chatbot server (same LAN).

config MY_UI_CHATBOT_PORT
    int "Chatbot port"
    default 3333
    range 1 65535
    help
        Port the Chatbot server listens on (see services/Chatbot/.env PORT).

config MY_UI_CHATBOT_TLS
    bool "Use TLS (wss://)"
    default n
    help
        Enable this if your server terminates TLS and you have CA configured.

config MY_UI_CHATBOT_TLS_SKIP_CN
    bool "Skip TLS common-name (CN) check (dev only)"
    depends on MY_UI_CHATBOT_TLS
    default y
    help
        Development convenience. Keeps certificate chain validation but skips
        host name (CN/SAN) match. Only enable on trusted LAN during develop.

config MY_UI_CHATBOT_TLS_INSECURE
    bool "INSECURE: accept any certificate (dev only)"
    depends on MY_UI_CHATBOT_TLS
    default n
    help
        If enabled, the Chatbot client will not validate the server certificate
        chain. Use only for quick local testing. DO NOT enable for production.

config MY_UI_CHATBOT_PATH
    string "WebSocket path"
    default "/ws"
    help
        WebSocket endpoint path of the Chatbot server.

endmenu

menu "Chatbot Advanced"

config MY_UI_CHATBOT_RECONNECT_TIMEOUT_MS
    int "Reconnect timeout (ms)"
    default 10000
    range 1000 600000
    help
        Time to wait before the client tries to reconnect after a
        disconnect or handshake error. Set to 0 to disable auto-reconnect.

config MY_UI_CHATBOT_PING_INTERVAL_SEC
    int "WebSocket ping interval (sec)"
    default 10
    range 0 600
    help
        Interval for WebSocket PING frames. 0 disables periodic PING.

config MY_UI_CHATBOT_NET_TIMEOUT_MS
    int "Network read/write timeout (ms)"
    default 8000
    range 100 60000
    help
        Timeout used for network read/write operations.

config MY_UI_CHATBOT_KEEPALIVE
    bool "Enable TCP keep-alive"
    default y
    help
        Enable TCP keep-alive on the underlying transport.

config MY_UI_CHATBOT_KEEPALIVE_IDLE
    int "Keep-alive idle (sec)"
    depends on MY_UI_CHATBOT_KEEPALIVE
    default 5
    range 1 3600

config MY_UI_CHATBOT_KEEPALIVE_INTERVAL
    int "Keep-alive interval (sec)"
    depends on MY_UI_CHATBOT_KEEPALIVE
    default 5
    range 1 3600

config MY_UI_CHATBOT_KEEPALIVE_COUNT
    int "Keep-alive count"
    depends on MY_UI_CHATBOT_KEEPALIVE
    default 3
    range 1 20

endmenu

menu "Weather Service Options"

config MY_UI_WEATHER_HOST
    string "Weather service host or IP"
    default "192.168.1.2"
    help
        Hostname or IP of services/weather-service running on your PC.

config MY_UI_WEATHER_PORT
    int "Weather service port"
    range 1 65535
    default 3000

config MY_UI_WEATHER_SCHEME
    bool "Use HTTPS for weather service"
    default n
    help
        Enable if you reverse-proxy the service behind TLS. For local dev
        keep it disabled (HTTP).

endmenu
```

## software_part/components/02_middleware/audio_player/Kconfig
```kconfig
menu "Audio Player"

config AUDIO_PLAYER_HTTP_BUFSZ
    int "HTTP request chunk size (bytes)"
    range 1024 32768
    default 8192
    help
        Size of each HTTP(S) read request. Larger values reduce CPU wakeups
        and can improve throughput on stable networks at the cost of latency.

config AUDIO_PLAYER_RINGBUF_SZ
    int "Pipeline ring buffer size (bytes)"
    range 8192 262144
    default 65536
    help
        Size of the ring buffer between HTTP -> decoder and decoder -> I2S.
        Larger buffers reduce underruns on bursty networks.

config AUDIO_PLAYER_HTTP_STACK_IN_EXT
    bool "Place HTTP stream task stack in external RAM (PSRAM)"
    default n
    help
        When disabled (recommended), the HTTP stream task stack stays in
        internal RAM for better latency. Enable only if internal RAM is tight.

config AUDIO_PLAYER_HTTP_TASK_PRIO
    int "HTTP stream task priority"
    range 3 10
    default 8

config AUDIO_PLAYER_DEC_STACK_IN_EXT
    bool "Place decoder task stack in external RAM (PSRAM)"
    default y
    help
        When enabled, decoder tasks try to allocate their stack in external
        RAM (PSRAM). This can significantly reduce pressure on internal RAM
        on ESP32-S3 with SPIRAM stack enabled. Disable if you see instability
        around decoder tasks.

config AUDIO_PLAYER_DEC_TASK_PRIO
    int "Decoder task priority"
    range 3 10
    default 7

config AUDIO_PLAYER_I2S_SINK_BUF
    int "I2S sink bridge buffer (bytes)"
    range 1024 16384
    default 4096

endmenu

# Prefill options removed: reverted to immediate playback
```

## software_part/components/02_middleware/http_stream/Kconfig
```kconfig
menu "HTTP Stream options"

config HTTP_STREAM_SUPPORT_GZIP
    bool "Enable gzip decompression (miniz)"
    default y
    help
      Enable if your server sends Content-Encoding: gzip.
      We’ll compile lib/gzip/gzip_miniz.c when enabled.

config HTTP_STREAM_SUPPORT_PLAYLIST
    bool "Enable HLS (.m3u8) playlist support"
    default y
    help
      Parse M3U8 playlists and resolve segment URIs.
      When enabled, we build http_playlist.c and lib/hls/hls_playlist.c.

endmenu
```

## software_part/components/02_middleware/iot_mqtt/Kconfig
```kconfig
menu "IoT MQTT (EMQX uplink)"

config IOT_MQTT_ENABLE
    bool "Enable MQTT uplink for IoT platform"
    default y
    help
        Enable ESP-MQTT client to publish telemetry to the IoT cloud platform
        (EMQX broker). Disable if MQTT is not needed.

config IOT_MQTT_BROKER_URI
    string "MQTT broker URI"
    depends on IOT_MQTT_ENABLE
    default "mqtt://servers.local:1883"
    help
        URI to connect, e.g. mqtt://<host>:1883 . Use WebSocket only if
        required; TCP is recommended for the ESP32 device.

config IOT_MQTT_USERNAME
    string "MQTT username"
    depends on IOT_MQTT_ENABLE
    default "iot_core"

config IOT_MQTT_PASSWORD
    string "MQTT password"
    depends on IOT_MQTT_ENABLE
    default ""
    help
        MQTT password for the uplink user. Keep it empty in the repo and set it
        locally via menuconfig / sdkconfig.

config IOT_MQTT_DEVICE_ID
    string "Device ID used in topic devices/<id>/state"
    depends on IOT_MQTT_ENABLE
    default "ESP32S3_001"

config IOT_MQTT_PUB_PERIOD_MS
    int "Publish period (ms) for telemetry"
    depends on IOT_MQTT_ENABLE
    range 1000 60000
    default 5000

endmenu
```

## software_part/components/02_middleware/lvgl_port/Kconfig
```kconfig
menu "LVGL Port"

config LVGL_PORT_TASK_STACK_SIZE
    int "LVGL task stack size (bytes)"
    range 4096 65536
    default 16384
    help
      LVGL 后台任务栈大小。GUI Guider 生成的界面建议 >= 16 KB。

config LVGL_PORT_BUF_LINES
    int "LVGL partial buffer lines"
    range 10 200
    default 40
    help
      LVGL 局部渲染缓冲的行数。数值越大，刷屏吞吐越高，内存占用也越高。

config LVGL_PORT_TICK_MS
    int "LVGL handler period (ms)"
    range 1 20
    default 5
    help
      lv_timer_handler() 调用周期（毫秒）。

endmenu
```

## software_part/components/02_middleware/lvgl_port/Kconfig.projbuild
```kconfig
menu "LVGL extra options"
    config LV_COLOR_16_SWAP
        bool "Swap the 2 bytes of RGB565 color"
        default n

    config LVGL_PORT_EXTRA_MEM_KB
        int "Extra LVGL heap size (KB)"
        default 128 if SPIRAM
        default 0
        range 0 512
        help
            Allocate an additional TLSF pool for LVGL on top of CONFIG_LV_MEM_SIZE_KILOBYTES.
            Set to 0 to disable. When SPIRAM is present we default to 128 KB.
endmenu
```

## software_part/components/02_middleware/net_rtt_ping/Kconfig
```kconfig
menu "RTT Ping (CSV)"

config NET_PING_CSV_FLUSH_EACH
    bool "fflush(stdout) after each CSV line"
    default n
    help
        关闭后只在汇总时 flush，可降低串口 I/O 抖动和 CPU 占用。

endmenu
```

## software_part/components/02_middleware/net_wifi_scan/Kconfig
```kconfig
menu "Wi-Fi Scan (CSV)"

config NET_WIFI_SCAN_ON_BOOT
    bool "Run one Wi-Fi scan after connected"
    default n

config NET_WIFI_SCAN_SHOW_HIDDEN
    bool "Show hidden SSIDs"
    default y

config NET_WIFI_SCAN_ACTIVE_MIN_MS
    int "Active scan dwell min (ms)"
    range 0 500
    default 100

config NET_WIFI_SCAN_ACTIVE_MAX_MS
    int "Active scan dwell max (ms)"
    range 0 1000
    default 300

config NET_WIFI_SCAN_USE_PSRAM
    bool "Allocate scan records in PSRAM when available"
    default y
    help
        大量 AP 结果（>100）时优先使用 PSRAM，避免内存高峰占用内部 RAM。

endmenu
```

## software_part/components/02_middleware/net_wifi_sntp/Kconfig
```kconfig
menu "Wi-Fi + SNTP (net_wifi_sntp)"

config NET_WIFI_SSID
    string "Wi-Fi SSID"
    default "YourWiFi"

config NET_WIFI_PASSWORD
    string "Wi-Fi 密码"
    default "YourPassword"

config NET_WIFI_FAILURE_RETRY
    int "驱动内建连接重试次数（failure_retry_cnt，0=只尝试一次）"
    range 0 15
    default 5

config NET_WIFI_BACKOFF_BASE_MS
    int "断线应用侧指数退避起始 (ms)"
    default 500

config NET_WIFI_BACKOFF_MAX_MS
    int "断线应用侧指数退避上限 (ms)"
    default 30000

config NET_WIFI_POWER_SAVE
    bool "启用 Wi-Fi 省电（Modem-PS）"
    default y

config NET_SNTP_TZ
    string "本地时区 TZ 字符串（POSIX 形式，如 CST-8 表示北京时间 UTC+8）"
    default "CST-8"

config NET_SNTP_SERVER_1
    string "NTP 服务器 1"
    default "time.cloudflare.com"

config NET_SNTP_SERVER_2
    string "NTP 服务器 2"
    default "pool.ntp.org"

config NET_SNTP_SERVER_3
    string "NTP 服务器 3"
    default "time.google.com"

config NET_SNTP_SYNC_INTERVAL_MS
    int "SNTP 重同步周期 (ms)"
    range 10000 86400000
    default 3600000
    help
        建议 >= 10 秒。常见生产值为 1 小时。

endmenu
```

## software_part/components/02_middleware/voice_afe/Kconfig.projbuild
```kconfig
menu "Voice AFE (WakeNet / MultiNet wrapper)"

config VOICE_AFE_ENABLE
    bool "Enable voice AFE middleware"
    default n
    help
        Wrap INMP441 PCM capture with optional ESP-SR AFE (WakeNet+MultiNet) and expose
        unified callbacks for PCM streaming and command events.

config VOICE_AFE_USE_GMF
    bool "Use espressif/gmf_ai_audio + ESP-SR"
    default n
    depends on VOICE_AFE_ENABLE
    help
        When enabled, the middleware instantiates gmf_ai_audio AFE to run WakeNet/MultiNet locally.
        When disabled, it falls back to raw INMP441 PCM with no wake/command detection.

config VOICE_AFE_PCM_BUFFER_SAMPLES
    int "PCM buffer samples per chunk"
    range 128 2048
    default 256
    depends on VOICE_AFE_ENABLE
    help
        Number of 16-bit mono samples to read per loop when not using GMF (legacy mode).
        256 samples at 16 kHz ≈ 16 ms.

endmenu
```

## software_part/components/02_middleware/weather_client/Kconfig
```kconfig
menu "Weather Client"

config WEATHER_CLIENT_URL
    string "Weather service URL"
    default "http://localhost:3334/api/current?city=Beijing"
    help
        REST endpoint providing current weather description JSON,
        expected to return { \"weather\": \"<text>\" }.

config WEATHER_CLIENT_TIMEOUT_MS
    int "HTTP timeout (ms)"
    default 5000
    range 1000 30000
    help
        Timeout for weather HTTP requests. Increase if server is remote.

endmenu
```
